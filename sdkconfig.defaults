## sdkconfig.defaults
```kconfig
# Cardputer (original + ADV), M5Stamp-S3: ESP32-S3FN8 — 8 MB flash
# (DIO/80MHz), 512 KB SRAM, no PSRAM.
CONFIG_IDF_TARGET="esp32s3"
CONFIG_ESP_DEFAULT_CPU_FREQ_MHZ_240=y
CONFIG_ESPTOOLPY_FLASHMODE_DIO=y
CONFIG_ESPTOOLPY_FLASHFREQ_80M=y
CONFIG_ESPTOOLPY_FLASHSIZE_8MB=y

# Single 6 MB factory app slot — code + embedded Q4 model in one image.
CONFIG_PARTITION_TABLE_CUSTOM=y
CONFIG_PARTITION_TABLE_CUSTOM_FILENAME="partitions.csv"

# Inference hot loops want -O2 (flash space is not the constraint here).
CONFIG_COMPILER_OPTIMIZATION_PERF=y

# app_main runs the chat loop + UI (std::string, vsnprintf, M5GFX).
CONFIG_ESP_MAIN_TASK_STACK_SIZE=8192

# 1 ms tick so the idle keyboard poll (vTaskDelay(1)) stays responsive.
CONFIG_FREERTOS_HZ=1000

# Generation occupies both cores (main task + pinned matmul worker), so the
# idle tasks can starve for the length of a reply. Don't let the task WDT
# panic on that — same behaviour the Arduino core build had.
CONFIG_ESP_TASK_WDT_CHECK_IDLE_TASK_CPU0=n
CONFIG_ESP_TASK_WDT_CHECK_IDLE_TASK_CPU1=n
```
