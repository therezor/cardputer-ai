// Cardputer ADV — on-device story chat with TinyStories-Instruct-3M (GPT-Neo).
//
// The Q4_0 model and pruned GPT-2 tokenizer are compiled into the firmware
// (model_data.cpp and tok_data.cpp, generated by
// tools/convert_tinystories_instruct.py). The engine also still runs the old
// TinyLLama-v0 export (tools/convert_tinyllama_v0.py) — the model header
// selects the architecture at boot.
//
// Chat mode wraps whatever you type into the instruction format the model was
// trained on ("Summary: <your text>\nStory:", so asking for "a dragon who
// learns to share" gets a story about exactly that. Raw mode feeds your text
// in unchanged (plain completion).

#include <M5Unified.h>
#include <esp_random.h>
#include <string>
#include <math.h>
#include <string.h>
#include <stdlib.h>
#include "keyboard/Keyboard.h"
#include "llm.h"
#include "ui.h"
#include "port.h"

// Symbols defined by the generated model_data.cpp and tok_data.cpp (produced
// by tools/convert_tinystories_instruct.py). They land in the .rodata section,
// which the ESP32-S3 maps from flash directly into the data address space — so
// inference reads them as if they were ordinary RAM.
extern "C" const uint8_t MODEL_DATA[];
extern "C" const size_t  MODEL_DATA_LEN;
extern "C" const uint8_t TOKENIZER_DATA[];
extern "C" const size_t  TOKENIZER_DATA_LEN;

static Transformer    transformer;
static Tokenizer      tokenizer;
static Sampler        sampler;
static ChatUI         ui;
static Keyboard_Class Keyboard;   // vendored M5Cardputer driver (main/keyboard/)

// KV-cache window. dim=128 × 8 layers × (k+v) at int8 ≈ 2 KB per position
// (llm.cpp stores the GPT-Neo cache as int8 with per-row scales); 80 positions
// ≈ 165 KB, sharing ~280 KB free heap with the 48 KB logits buffer. The
// converter keeps 256 position embeddings, so flash isn't the limit — RAM is.
static constexpr int KV_SEQ_LEN = 80;
static constexpr float DEFAULT_TEMP = 0.8f;

enum AppState { ST_BOOT, ST_CHAT, ST_SETTINGS };
static AppState state = ST_BOOT;

static float clampf(float v, float lo, float hi) { return v < lo ? lo : (v > hi ? hi : v); }
static int   clampi(int v, int lo, int hi)       { return v < lo ? lo : (v > hi ? hi : v); }

// ---------- Settings ----------

enum ChatMode { M_CHAT, M_STORY, M_RAW };

struct Settings {
  float temp      = DEFAULT_TEMP;     // 0.0 = greedy (argmax)
  int   max_reply = 44;               // tokens per reply; -1 = unlimited (stop at KV or EOS);
                                      // -2 = unsafe (wrap KV pos, run until EOS fires)
  int   mode      = M_CHAT;
};
static Settings settings;
static int sett_sel = 0;
static constexpr int SETT_N = 4;

static const char* modeName(int m) {
  switch (m) {
    case M_CHAT:  return "chat (User/Bot)";
    case M_STORY: return "story (Summary:)";
    default:      return "raw completion";
  }
}

static void drawSettings() {
  std::string names[SETT_N]  = {"Mode", "Temperature", "Max reply tokens", "RNG seed"};
  std::string values[SETT_N];
  char tbuf[16];
  snprintf(tbuf, sizeof(tbuf), "%.1f", settings.temp);
  values[0] = modeName(settings.mode);
  values[1] = settings.temp < 0.05f ? "0.0 greedy" : tbuf;
  values[2] = settings.max_reply == -2 ? "unsafe" :
              settings.max_reply <  0  ? "unlimited" :
                                         std::to_string(settings.max_reply);
  values[3] = "reroll with , /";
  ui.showSettings("Settings", names, values, SETT_N, sett_sel);
}

static void adjustSetting(int dir) {
  switch (sett_sel) {
    case 0:
      settings.mode = (settings.mode + 3 + dir) % 3;
      break;
    case 1:
      settings.temp = roundf((settings.temp + 0.1f * dir) * 10.0f) / 10.0f;
      settings.temp = clampf(settings.temp, 0.0f, 2.0f);
      sampler.temperature = settings.temp;        // takes effect immediately
      break;
    case 2:
      if      (dir < 0 && settings.max_reply == -1) settings.max_reply = -2;
      else if (dir < 0 && settings.max_reply <= 4)  settings.max_reply = -1;
      else if (dir > 0 && settings.max_reply == -2) settings.max_reply = -1;
      else if (dir > 0 && settings.max_reply <  0)  settings.max_reply = 4;
      else settings.max_reply = clampi(settings.max_reply + dir, 4, KV_SEQ_LEN - 8);
      break;
    case 3:
      llm_build_sampler(&sampler, transformer.config.vocab_size,
                        settings.temp, esp_random());
      break;
  }
  drawSettings();
}

// ---------- Chat history (chat mode only) ----------
//
// The fine-tune's format is "User: <u>\nBot: <b><|endoftext|>\nUser: ..." —
// we rebuild exactly that token stream every turn, inserting eos_id between
// exchanges by hand (the EOS string isn't reachable through BPE merges).
static constexpr int HIST_MAX = 4;
static std::string hist_user[HIST_MAX], hist_bot[HIST_MAX];
static int         hist_n = 0;

static void historyPush(const std::string& u, const std::string& b) {
  if (hist_n == HIST_MAX) {
    for (int i = 1; i < HIST_MAX; i++) { hist_user[i-1] = hist_user[i]; hist_bot[i-1] = hist_bot[i]; }
    hist_n--;
  }
  hist_user[hist_n] = u;
  hist_bot[hist_n]  = b;
  hist_n++;
}

static void historyClear() {
  for (int i = 0; i < HIST_MAX; i++) { hist_user[i] = ""; hist_bot[i] = ""; }
  hist_n = 0;
}

static void leaveSettings() {
  state = ST_CHAT;
  ui.repaint();
  ui.statusf("T=%.1f  len=%d  [tab] settings", settings.temp, settings.max_reply);
}

struct GenState {
  bool active = false;
  int pos = 0, next = 0, token = 0, n_prompt = 0;
  int* prompt_tokens = nullptr;
  uint32_t t_start_ms = 0;
  int tokens_out = 0;
  std::string user_text;   // chat mode: pending exchange for the history
  std::string bot_text;
  bool pending_nl = false; // hold back a lone "\n" until we know what follows
  bool wrapped    = false; // true if unsafe mode has wrapped pos (context corrupted)
} gen;

static void initModel() {
  ui.statusf("Loading model (%u KB)...", (unsigned)(MODEL_DATA_LEN / 1024));
  if (!llm_init_embedded(&transformer, MODEL_DATA, MODEL_DATA_LEN, KV_SEQ_LEN)) {
    ui.fatal("model init failed (bad header or OOM)");
  }
  ui.statusf("Tokenizer (%u KB)...", (unsigned)(TOKENIZER_DATA_LEN / 1024));
  if (!llm_tokenizer_from_memory(&tokenizer, TOKENIZER_DATA, TOKENIZER_DATA_LEN,
                                 transformer.config.vocab_size)) {
    ui.fatal("tokenizer init failed");
  }
  // model_data.cpp and tok_data.cpp are generated as a pair; a stale build
  // cache that mixes generations produces silent gibberish. Refuse to run.
  if (tokenizer.vocab_size != transformer.config.vocab_size) {
    ui.fatal("model/tokenizer vocab mismatch - clean rebuild needed");
  }
  llm_build_sampler(&sampler, transformer.config.vocab_size, DEFAULT_TEMP, esp_random());
}

// Encode `text` into gen.prompt_tokens starting at *n (bounds-checked).
static bool appendSegment(const std::string& text, int cap, int* n) {
  int  m = 0;
  int* tmp = (int*) malloc(sizeof(int) * (text.length() + 8));
  if (!tmp) return false;
  llm_encode(&tokenizer, text.c_str(), 0, 0, tmp, &m);
  bool ok = (*n + m <= cap);
  if (ok) { memcpy(gen.prompt_tokens + *n, tmp, m * sizeof(int)); *n += m; }
  free(tmp);
  return ok;
}

static void beginGeneration(const std::string& user_text) {
  // Prompt shapes (chat/story match the two training formats):
  //   chat : User: <u1>\nBot: <b1><eos>\nUser: <u2>\nBot:
  //   story: Summary: <text>\nStory:
  //   raw  : <text>
  const bool neo = (tokenizer.style == ARCH_GPTNEO);
  int mode = neo ? settings.mode : M_RAW;

  // Leave room for the reply: everything the prompt doesn't use, the model
  // can spend on talking back.
  int budget = KV_SEQ_LEN - (settings.max_reply >= 0 ? settings.max_reply : 0) - 1;
  if (budget < 8) budget = 8;

  if (gen.prompt_tokens) { free(gen.prompt_tokens); gen.prompt_tokens = nullptr; }
  gen.prompt_tokens = (int*) malloc(sizeof(int) * (budget + 8));
  if (!gen.prompt_tokens) { ui.appendBot("[OOM]\n"); return; }

  int n = 0;
  if (mode == M_CHAT) {
    // Encode each candidate segment once; include newest exchanges first
    // until the budget is full, then emit oldest -> newest.
    int* seg_toks[HIST_MAX + 1];
    int  seg_len[HIST_MAX + 1];
    std::string segs[HIST_MAX + 1];
    for (int i = 0; i < hist_n; i++)
      segs[i] = "User: " + hist_user[i] + "\nBot:" + hist_bot[i];
    segs[hist_n] = "User: " + user_text + "\nBot:";

    int total = 0;
    for (int i = 0; i <= hist_n; i++) {
      seg_toks[i] = (int*) malloc(sizeof(int) * (segs[i].length() + 8));
      seg_len[i]  = 0;
      if (seg_toks[i])
        llm_encode(&tokenizer, segs[i].c_str(), 0, 0, seg_toks[i], &seg_len[i]);
    }
    int first = hist_n;                         // oldest exchange included
    total = seg_len[hist_n];
    while (first > 0 && total + seg_len[first-1] + 2 <= budget) {
      total += seg_len[first-1] + 2;            // +eos +"\n" joiners
      first--;
    }
    if (total <= budget) {
      for (int i = first; i < hist_n; i++) {
        memcpy(gen.prompt_tokens + n, seg_toks[i], seg_len[i] * sizeof(int));
        n += seg_len[i];
        gen.prompt_tokens[n++] = tokenizer.eos_id;
        appendSegment("\n", budget + 8, &n);
      }
      memcpy(gen.prompt_tokens + n, seg_toks[hist_n], seg_len[hist_n] * sizeof(int));
      n += seg_len[hist_n];
    } else {
      // Current message alone overflows: truncate it and re-add "\nBot:".
      n = (budget - 4 < seg_len[hist_n]) ? budget - 4 : seg_len[hist_n];
      memcpy(gen.prompt_tokens, seg_toks[hist_n], n * sizeof(int));
      appendSegment("\nBot:", budget + 8, &n);
    }
    for (int i = 0; i <= hist_n; i++) free(seg_toks[i]);
    gen.user_text = user_text;
  } else if (mode == M_STORY) {
    if (!appendSegment("Summary: " + user_text + "\nStory:", budget, &n)) {
      n = 0;
      appendSegment("Summary: " + user_text, budget, &n);
      if (n > budget - 4) n = budget - 4;
      appendSegment("\nStory:", budget, &n);
    }
  } else {
    if (neo) {
      appendSegment(user_text, budget, &n);
    } else {
      // LLaMA path keeps its BOS + SentencePiece behaviour.
      llm_encode(&tokenizer, user_text.c_str(), 1, 0, gen.prompt_tokens, &n);
      if (n > budget) n = budget;
    }
  }
  gen.n_prompt = n;

  if (gen.n_prompt < 1) { ui.appendBot("[empty]\n"); return; }
  gen.token       = gen.prompt_tokens[0];
  gen.pos         = 0;
  gen.next        = 0;
  gen.active      = true;
  gen.t_start_ms  = millis();
  gen.tokens_out  = 0;
  gen.bot_text    = "";
  gen.pending_nl  = false;
  gen.wrapped     = false;
  ui.beginBotReply();
}

static void finishReply() {
  gen.active = false;
  bool was_wrapped = gen.wrapped;
  if (settings.mode == M_CHAT && tokenizer.style == ARCH_GPTNEO && gen.bot_text.length())
    historyPush(gen.user_text, gen.bot_text);
  ui.endBotReply(gen.tokens_out, millis() - gen.t_start_ms);
  if (was_wrapped) {
    int total_tok = gen.tokens_out;
    historyClear();
    ui.statusf("context wrapped - %d tokens - new convo", total_tok);
  }
}

static void stepGeneration() {
  if (gen.pos >= KV_SEQ_LEN - 1) {
    if (settings.max_reply == -2) {
      gen.pos     = gen.n_prompt;  // wrap: overwrite output KV region, keep going
      gen.wrapped = true;
    } else {
      finishReply(); return;
    }
  }
  if (settings.max_reply >= 0 && gen.tokens_out >= settings.max_reply) {
    finishReply();
    return;
  }
  float* logits = llm_forward(&transformer, gen.token, gen.pos);

  if (gen.pos < gen.n_prompt - 1) {
    gen.next = gen.prompt_tokens[gen.pos + 1];
  } else {
    gen.next = llm_sample(&sampler, logits);
    bool is_eos = (tokenizer.style == ARCH_GPTNEO)
                      ? (gen.next == tokenizer.eos_id)
                      : (gen.next == 1 || gen.next == 2);
    if (is_eos) {
      finishReply();
      return;
    }
    char scratch[32];
    const char* piece = llm_decode(&tokenizer, gen.token, gen.next, scratch, sizeof(scratch));
    if (piece && *piece) {
      // The fine-tune normally ends replies with EOS, but if the model
      // starts a "\nUser:" turn instead, cut it there. A lone newline is
      // held back one step so it never gets printed before we know.
      if (settings.mode == M_CHAT && tokenizer.style == ARCH_GPTNEO) {
        if (gen.pending_nl) {
          if (strncmp(piece, "User", 4) == 0) { finishReply(); return; }
          ui.appendBot("\n");
          gen.bot_text += "\n";
          gen.pending_nl = false;
        }
        if (strcmp(piece, "\n") == 0) {
          gen.pending_nl = true;
        } else {
          ui.appendBot(piece);
          gen.bot_text += piece;
        }
      } else {
        ui.appendBot(piece);
      }
    }
    gen.tokens_out++;
  }
  gen.token = gen.next;
  gen.pos++;
}

static void setup() {
  auto cfg = M5.config();
  M5.begin(cfg);
  Keyboard.begin();    // picks IOMatrix or TCA8418 reader from M5.getBoard()
  ui.begin();

  ui.status("BRAINROT.EXE booting...");
  initModel();

  ui.ready();
  ui.statusf("%s  T=%.1f  /new resets  [tab] settings",
             transformer.config.arch == ARCH_GPTNEO ? "BRAINROT.EXE" : "TinyLLama-v0",
             settings.temp);
  state = ST_CHAT;
}

static void loop() {
  M5.update();
  Keyboard.updateKeyList();
  Keyboard.updateKeysState();

  if (state == ST_SETTINGS) {
    if (Keyboard.isChange() && Keyboard.isPressed()) {
      auto st = Keyboard.keysState();
      if (st.tab || st.enter) { leaveSettings(); return; }
      for (char c : st.word) {
        if (c == ';') { sett_sel = (sett_sel + SETT_N - 1) % SETT_N; drawSettings(); }
        if (c == '.') { sett_sel = (sett_sel + 1) % SETT_N; drawSettings(); }
        if (c == ',') adjustSetting(-1);
        if (c == '/') adjustSetting(+1);
      }
    }
    return;
  }
  if (state != ST_CHAT) return;

  if (gen.active) {
    ui.tickGenerating(gen.tokens_out);
    if (Keyboard.isChange() && Keyboard.isPressed()) {
      auto st = Keyboard.keysState();
      for (char c : st.word) {
        if (c == '`') { finishReply(); return; }
      }
    }
    stepGeneration();
    return;
  }
  if (Keyboard.isChange() && Keyboard.isPressed()) {
    auto st = Keyboard.keysState();
    if (st.tab) {                      // open settings (only when idle)
      state = ST_SETTINGS;
      sett_sel = 0;
      drawSettings();
      return;
    }
    if (st.fn) {
      // fn+; / fn+. are the up/down arrows on the Cardputer keyboard —
      // scroll the chat history (2 lines per press).
      for (char c : st.word) {
        if (c == ';') ui.scrollChat(+2);
        if (c == '.') ui.scrollChat(-2);
      }
    } else {
      for (char c : st.word) ui.onChar(c);
      if (st.del)   ui.onBackspace();
      if (st.enter) {
        std::string prompt = ui.takeInput();
        if (prompt == "/new") {
          historyClear();
          ui.statusf("new conversation  [tab] settings");
        } else if (prompt.length()) {
          ui.appendUser(prompt);
          beginGeneration(prompt);
        }
      }
    }
  }
}

extern "C" void app_main(void) {
  setup();
  for (;;) {
    loop();
    // Full speed while generating (one token per iteration); when idle, a
    // 1 ms tick (CONFIG_FREERTOS_HZ=1000) is plenty for keyboard polling.
    if (!gen.active) vTaskDelay(1);
  }
}
