// Cardputer ADV — on-device story chat with TinyStories-Instruct-3M (GPT-Neo).
//
// The Q4_0 model and pruned GPT-2 tokenizer are compiled into the firmware
// (model_data.cpp and tok_data.cpp, generated by
// tools/convert_tinystories_instruct.py). The engine also still runs the old
// TinyLLama-v0 export (tools/convert_tinyllama_v0.py) — the model header
// selects the architecture at boot.
//
// Chat mode wraps whatever you type into the instruction format the model was
// trained on ("Summary: <your text>\nStory:", so asking for "a dragon who
// learns to share" gets a story about exactly that. Raw mode feeds your text
// in unchanged (plain completion).

#include <M5Unified.h>
#include <esp_random.h>
#include <string>
#include <math.h>
#include <string.h>
#include <stdlib.h>
#include "keyboard/Keyboard.h"
#include "llm.h"
#include "ui.h"
#include "port.h"

// Symbols defined by the generated model_data.cpp and tok_data.cpp (produced
// by tools/convert_tinystories_instruct.py). They land in the .rodata section,
// which the ESP32-S3 maps from flash directly into the data address space — so
// inference reads them as if they were ordinary RAM.
extern "C" const uint8_t MODEL_DATA[];
extern "C" const size_t  MODEL_DATA_LEN;
extern "C" const uint8_t TOKENIZER_DATA[];
extern "C" const size_t  TOKENIZER_DATA_LEN;

static Transformer    transformer;
static Tokenizer      tokenizer;
static Sampler        sampler;
static ChatUI         ui;
static Keyboard_Class Keyboard;   // vendored M5Cardputer driver (main/keyboard/)

// KV-cache window. llm.cpp stores the GPT-Neo cache as int4 nibbles with one
// bf16 scale per 32-element group: ~0.6 KB/position at dim=128 (3M model,
// 80 positions ≈ 90 KB) and ~1.2 KB/position at dim=256 (8M model — 72
// positions ≈ 166 KB, sharing ~280 KB free heap with the ~50 KB logits
// buffer). The converter keeps 256 position embeddings, so flash isn't the
// limit — RAM is. The window is picked from the model header at boot.
static int KV_SEQ_LEN = 80;
static int kvLenForModel() {
  // dim is bytes 8..11 of the CRDP header (see llm.cpp llm_init_embedded)
  int dim;
  memcpy(&dim, MODEL_DATA + 8, 4);
  return dim <= 128 ? 80 : 72;
}
static constexpr float DEFAULT_TEMP  = 0.8f;
static constexpr float DEFAULT_TOP_P = 0.9f;   // 1.0 = off (full multinomial)
// Upper bound for a *numeric* max-reply setting. The sliding window decouples
// this from KV_SEQ_LEN, but not from the learned position table: past seq_len
// positions every token reuses the last wpe row, so that is the real ceiling.
// Set from the model header at boot.
static int MAX_REPLY_CAP = 256;
// Sliding-window eviction geometry, as a fraction of the KV window: at most
// KV_SEQ_LEN/SLIDE_DIV slots stay pinned at the head, and each slide drops
// KV_SEQ_LEN/SLIDE_DIV slots after them. A quarter is the useful compromise -
// see the eviction-band reasoning at the slide site in stepGeneration().
static constexpr int SLIDE_DIV = 4;

enum AppState { ST_BOOT, ST_CHAT, ST_SETTINGS };
static AppState state = ST_BOOT;

static float clampf(float v, float lo, float hi) { return v < lo ? lo : (v > hi ? hi : v); }
static int   clampi(int v, int lo, int hi)       { return v < lo ? lo : (v > hi ? hi : v); }

// ---------- Settings ----------

enum ChatMode { M_CHAT, M_STORY, M_RAW };

struct Settings {
  float temp      = DEFAULT_TEMP;     // 0.0 = greedy (argmax)
  float top_p     = DEFAULT_TOP_P;    // nucleus mass; 1.0 = off
  int   max_reply = -1;               // tokens per reply; -1 = run until EOS, sliding the
                                      // context window (still bounded by seq_len positions).
                                      // Settings aren't persisted, so this is what every
                                      // boot starts at.
  int   mode      = M_CHAT;
};
static Settings settings;
static int sett_sel = 0;
static constexpr int SETT_N = 5;

static const char* modeName(int m) {
  switch (m) {
    case M_CHAT:  return "chat (User/Bot)";
    case M_STORY: return "story (Summary:)";
    default:      return "raw completion";
  }
}

static void drawSettings() {
  std::string names[SETT_N]  = {"Mode", "Temperature", "Top-p", "Max reply tokens", "RNG seed"};
  std::string values[SETT_N];
  char tbuf[16], pbuf[16];
  snprintf(tbuf, sizeof(tbuf), "%.1f", settings.temp);
  snprintf(pbuf, sizeof(pbuf), "%.2f", settings.top_p);
  values[0] = modeName(settings.mode);
  values[1] = settings.temp < 0.05f ? "0.0 greedy" : tbuf;
  values[2] = settings.top_p >= 1.0f ? "1.00 off" : pbuf;
  values[3] = settings.max_reply < 0 ? "until eos (slides)"
                                     : std::to_string(settings.max_reply);
  values[4] = "reroll with , /";
  ui.showSettings("Settings", names, values, SETT_N, sett_sel);
}

static void adjustSetting(int dir) {
  switch (sett_sel) {
    case 0:
      settings.mode = (settings.mode + 3 + dir) % 3;
      break;
    case 1:
      settings.temp = roundf((settings.temp + 0.1f * dir) * 10.0f) / 10.0f;
      settings.temp = clampf(settings.temp, 0.0f, 2.0f);
      sampler.temperature = settings.temp;        // takes effect immediately
      break;
    case 2:
      settings.top_p = roundf((settings.top_p + 0.05f * dir) * 20.0f) / 20.0f;
      settings.top_p = clampf(settings.top_p, 0.05f, 1.0f);
      sampler.top_p = settings.top_p;             // takes effect immediately
      break;
    case 3:
      // The window now slides, so the reply length is decoupled from the KV
      // window: numbers can run well past it, and -1 keeps sliding until EOS
      // (or a `\`` press, or the position table runs out at seq_len). Scroll
      // below 4 to reach it.
      if      (dir < 0 && settings.max_reply <= 4) settings.max_reply = -1;
      else if (dir > 0 && settings.max_reply <  0) settings.max_reply = 4;
      else {
        // Coarse steps once the numbers get big - MAX_REPLY_CAP is the model's
        // whole position table, and stepping there one token at a time is a
        // few hundred keypresses.
        int step = settings.max_reply < 32 ? 1 : (settings.max_reply < 128 ? 8 : 32);
        settings.max_reply = clampi(settings.max_reply + dir * step, 4, MAX_REPLY_CAP);
      }
      break;
    case 4:
      llm_build_sampler(&sampler, transformer.config.vocab_size,
                        settings.temp, settings.top_p, esp_random());
      break;
  }
  drawSettings();
}

// ---------- Chat history (chat mode only) ----------
//
// The fine-tune's format is "User: <u>\nBot: <b><|endoftext|>\nUser: ..." —
// we rebuild exactly that token stream every turn, inserting eos_id between
// exchanges by hand (the EOS string isn't reachable through BPE merges).
static constexpr int HIST_MAX = 4;
static std::string hist_user[HIST_MAX], hist_bot[HIST_MAX];
static int         hist_n = 0;

static void historyPush(const std::string& u, const std::string& b) {
  if (hist_n == HIST_MAX) {
    for (int i = 1; i < HIST_MAX; i++) { hist_user[i-1] = hist_user[i]; hist_bot[i-1] = hist_bot[i]; }
    hist_n--;
  }
  hist_user[hist_n] = u;
  hist_bot[hist_n]  = b;
  hist_n++;
}

static void historyClear() {
  for (int i = 0; i < HIST_MAX; i++) { hist_user[i] = ""; hist_bot[i] = ""; }
  hist_n = 0;
}

static void leaveSettings() {
  state = ST_CHAT;
  ui.repaint();
  if (settings.max_reply < 0)
    ui.statusf("T=%.1f P=%.2f len=eos  [tab] settings",
               settings.temp, settings.top_p);
  else
    ui.statusf("T=%.1f P=%.2f len=%d  [tab] settings",
               settings.temp, settings.top_p, settings.max_reply);
}

struct GenState {
  bool active = false;
  int pos = 0, next = 0, token = 0, n_prompt = 0;
  int abspos = 0;          // absolute sequence position (feeds the wpe table);
                           // climbs even after the window slides pos back down
  int* prompt_tokens = nullptr;
  uint32_t t_start_ms = 0;
  int tokens_out = 0;
  std::string user_text;   // chat mode: pending exchange for the history
  std::string bot_text;
  bool pending_nl = false; // hold back a lone "\n" until we know what follows
  bool slid       = false; // true once the context window has slid at least once
} gen;

static void initModel() {
  ui.statusf("Loading model (%u KB)...", (unsigned)(MODEL_DATA_LEN / 1024));
  {
    // Flash streaming bandwidth (serial log only). Touching one word per
    // 64-byte cache line forces a line fill for the whole blob — the same
    // access pattern the matmuls have. QIO should read ~2x DIO's ~13 MB/s;
    // if this prints DIO-class numbers, the bootloader header still says DIO
    // (reflash with esptool, not Launcher).
    uint32_t t0 = millis();
    volatile uint32_t sink = 0;
    const volatile uint32_t* p32 = (const volatile uint32_t*)MODEL_DATA;
    for (size_t i = 0; i < MODEL_DATA_LEN / 4; i += 16) sink += p32[i];
    uint32_t dt = millis() - t0;
    (void)sink;
    if (dt > 0) {
      printf("[bench] flash stream: %u KB in %u ms = %.1f MB/s\n",
             (unsigned)(MODEL_DATA_LEN / 1024), (unsigned)dt,
             (float)MODEL_DATA_LEN / 1024.0f / 1024.0f * 1000.0f / (float)dt);
    }
  }
  KV_SEQ_LEN = kvLenForModel();
  if (!llm_init_embedded(&transformer, MODEL_DATA, MODEL_DATA_LEN, KV_SEQ_LEN)) {
    ui.fatal("model init failed (bad header or OOM)");
  }
  // llm_init_embedded clamps the requested window to the model's seq_len; read
  // back what it actually allocated so the slide arithmetic here can't drift
  // from the cache llm.cpp indexes.
  KV_SEQ_LEN   = transformer.kv_seq_len;
  MAX_REPLY_CAP = transformer.config.seq_len;
  ui.statusf("Tokenizer (%u KB)...", (unsigned)(TOKENIZER_DATA_LEN / 1024));
  if (!llm_tokenizer_from_memory(&tokenizer, TOKENIZER_DATA, TOKENIZER_DATA_LEN,
                                 transformer.config.vocab_size)) {
    ui.fatal("tokenizer init failed");
  }
  // model_data.cpp and tok_data.cpp are generated as a pair; a stale build
  // cache that mixes generations produces silent gibberish. Refuse to run.
  if (tokenizer.vocab_size != transformer.config.vocab_size) {
    ui.fatal("model/tokenizer vocab mismatch - clean rebuild needed");
  }
  llm_build_sampler(&sampler, transformer.config.vocab_size, DEFAULT_TEMP, DEFAULT_TOP_P,
                    esp_random());
  {
    // Serial-only decode benchmark: three real forward passes. This is the
    // number the whole design optimizes; if it regresses, check the boot
    // "SPI Mode" line first (flash streaming is the throughput ceiling).
    llm_forward(&transformer, 0, 0);          // warm-up (caches, worker task)
    uint32_t t0 = millis();
    for (int i = 1; i <= 3; i++) llm_forward(&transformer, 0, i);
    uint32_t dt = millis() - t0;
    printf("[bench] forward: %.0f ms/token (%.2f tok/s)\n",
           (float)dt / 3.0f, 3000.0f / (float)dt);
  }
}

// Encode `text` into gen.prompt_tokens starting at *n (bounds-checked).
static bool appendSegment(const std::string& text, int cap, int* n) {
  int  m = 0;
  int* tmp = (int*) malloc(sizeof(int) * (text.length() + 8));
  if (!tmp) return false;
  llm_encode(&tokenizer, text.c_str(), 0, 0, tmp, &m);
  bool ok = (*n + m <= cap);
  if (ok) { memcpy(gen.prompt_tokens + *n, tmp, m * sizeof(int)); *n += m; }
  free(tmp);
  return ok;
}

static void beginGeneration(const std::string& user_text) {
  // Prompt shapes (chat/story match the two training formats):
  //   chat : User: <u1>\nBot: <b1><eos>\nUser: <u2>\nBot:
  //   story: Summary: <text>\nStory:
  //   raw  : <text>
  const bool neo = (tokenizer.style == ARCH_GPTNEO);
  int mode = neo ? settings.mode : M_RAW;

  // The reply no longer needs reserved window space - once the window fills,
  // stepGeneration() slides it (pinning the prompt, evicting oldest output).
  // So the prompt may use almost the whole window; keep a small headroom so the
  // very first generated tokens don't trigger an immediate slide.
  int budget = KV_SEQ_LEN - 8;
  if (budget < 8) budget = 8;

  if (gen.prompt_tokens) { free(gen.prompt_tokens); gen.prompt_tokens = nullptr; }
  gen.prompt_tokens = (int*) malloc(sizeof(int) * (budget + 8));
  if (!gen.prompt_tokens) { ui.appendBot("[OOM]\n"); return; }

  int n = 0;
  if (mode == M_CHAT) {
    // Encode each candidate segment once; include newest exchanges first
    // until the budget is full, then emit oldest -> newest.
    int* seg_toks[HIST_MAX + 1];
    int  seg_len[HIST_MAX + 1];
    std::string segs[HIST_MAX + 1];
    for (int i = 0; i < hist_n; i++)
      segs[i] = "User: " + hist_user[i] + "\nBot:" + hist_bot[i];
    segs[hist_n] = "User: " + user_text + "\nBot:";

    int total = 0;
    for (int i = 0; i <= hist_n; i++) {
      seg_toks[i] = (int*) malloc(sizeof(int) * (segs[i].length() + 8));
      seg_len[i]  = 0;
      if (seg_toks[i])
        llm_encode(&tokenizer, segs[i].c_str(), 0, 0, seg_toks[i], &seg_len[i]);
    }
    int first = hist_n;                         // oldest exchange included
    total = seg_len[hist_n];
    while (first > 0 && total + seg_len[first-1] + 2 <= budget) {
      total += seg_len[first-1] + 2;            // +eos +"\n" joiners
      first--;
    }
    if (total <= budget) {
      for (int i = first; i < hist_n; i++) {
        memcpy(gen.prompt_tokens + n, seg_toks[i], seg_len[i] * sizeof(int));
        n += seg_len[i];
        gen.prompt_tokens[n++] = tokenizer.eos_id;
        appendSegment("\n", budget + 8, &n);
      }
      memcpy(gen.prompt_tokens + n, seg_toks[hist_n], seg_len[hist_n] * sizeof(int));
      n += seg_len[hist_n];
    } else {
      // Current message alone overflows: truncate it and re-add "\nBot:".
      n = (budget - 4 < seg_len[hist_n]) ? budget - 4 : seg_len[hist_n];
      memcpy(gen.prompt_tokens, seg_toks[hist_n], n * sizeof(int));
      appendSegment("\nBot:", budget + 8, &n);
    }
    for (int i = 0; i <= hist_n; i++) free(seg_toks[i]);
    gen.user_text = user_text;
  } else if (mode == M_STORY) {
    if (!appendSegment("Summary: " + user_text + "\nStory:", budget, &n)) {
      n = 0;
      appendSegment("Summary: " + user_text, budget, &n);
      if (n > budget - 4) n = budget - 4;
      appendSegment("\nStory:", budget, &n);
    }
  } else {
    if (neo) {
      appendSegment(user_text, budget, &n);
    } else {
      // LLaMA path keeps its BOS + SentencePiece behaviour.
      llm_encode(&tokenizer, user_text.c_str(), 1, 0, gen.prompt_tokens, &n);
      if (n > budget) n = budget;
    }
  }
  gen.n_prompt = n;

  if (gen.n_prompt < 1) { ui.appendBot("[empty]\n"); return; }
  gen.token       = gen.prompt_tokens[0];
  gen.pos         = 0;
  gen.abspos      = 0;
  gen.next        = 0;
  gen.active      = true;
  gen.t_start_ms  = millis();
  gen.tokens_out  = 0;
  gen.bot_text    = "";
  gen.pending_nl  = false;
  gen.slid        = false;
  ui.beginBotReply();
}

// `hit_pos_limit` distinguishes "ran out of position embeddings" (a hard stop
// mid-sentence) from a normal EOS/length finish, so a truncated reply doesn't
// read as a sliding artifact.
static void finishReply(bool hit_pos_limit = false) {
  gen.active = false;
  bool was_slid = gen.slid;
  if (settings.mode == M_CHAT && tokenizer.style == ARCH_GPTNEO && gen.bot_text.length())
    historyPush(gen.user_text, gen.bot_text);
  ui.endBotReply(gen.tokens_out, millis() - gen.t_start_ms);
  if (hit_pos_limit)
    ui.statusf("%d tokens - context limit reached, /new resets", gen.tokens_out);
  else if (was_slid)
    ui.statusf("%d tokens (window slid - earliest context dropped)", gen.tokens_out);
}

static void stepGeneration() {
  if (settings.max_reply >= 0 && gen.tokens_out >= settings.max_reply) {
    finishReply();
    return;
  }
  if (gen.abspos >= transformer.config.seq_len - 1) {
    // The learned position table is exhausted: every further token would reuse
    // wpe[seq_len-1], so positions stop carrying information and the reply
    // degenerates. Sliding buys physical room, not new positions - stop here.
    finishReply(true);
    return;
  }
  if (gen.pos >= KV_SEQ_LEN - 1 && gen.abspos >= gen.n_prompt - 1) {
    // Context window full (and prefill is done, so `gen.pos` is a write slot,
    // not a prompt_tokens index). Slide it: keep a short attention-sink prefix,
    // drop the oldest slots after it, shift the rest down, and keep going.
    // gen.abspos is NOT rewound - the evicted slots free physical room while
    // the sequence position keeps advancing.
    //
    // How much to pin matters more than it looks. In chat mode the *current*
    // question sits at the END of the prompt ("<history>\nUser: <q>\nBot:"),
    // so pinning a large prefix pins the oldest history and drags the eviction
    // band straight through the question being answered. Capping the pin at a
    // quarter window puts the band in the stale history instead, while still
    // pinning a short prompt (story/raw mode) whole so its premise survives.
    int keep_head = KV_SEQ_LEN / SLIDE_DIV;
    if (gen.n_prompt < keep_head) keep_head = gen.n_prompt;
    int evict = KV_SEQ_LEN / SLIDE_DIV;
    if (evict < 1) evict = 1;
    evict = llm_kv_slide(&transformer, keep_head, evict);
    if (evict < 1) { finishReply(); return; }   // cache untouched - don't rewind
    gen.pos -= evict;            // physical write slot moves back into the freed gap
    gen.slid = true;
  }
  float* logits = llm_forward_at(&transformer, gen.token, gen.pos, gen.abspos);

  // Prefill is indexed by the ABSOLUTE position: gen.pos rewinds on every slide
  // and would send us back into prompt replay mid-reply (re-emitting the prompt
  // tail forever). gen.abspos is monotone, and equals gen.pos until the first
  // slide - which can only happen once prefill is over.
  if (gen.abspos < gen.n_prompt - 1) {
    gen.next = gen.prompt_tokens[gen.abspos + 1];
  } else {
    gen.next = llm_sample(&sampler, logits);
    bool is_eos = (tokenizer.style == ARCH_GPTNEO)
                      ? (gen.next == tokenizer.eos_id)
                      : (gen.next == 1 || gen.next == 2);
    if (is_eos) {
      finishReply();
      return;
    }
    char scratch[32];
    const char* piece = llm_decode(&tokenizer, gen.token, gen.next, scratch, sizeof(scratch));
    if (piece && *piece) {
      // The fine-tune normally ends replies with EOS, but if the model
      // starts a "\nUser:" turn instead, cut it there. A lone newline is
      // held back one step so it never gets printed before we know.
      if (settings.mode == M_CHAT && tokenizer.style == ARCH_GPTNEO) {
        if (gen.pending_nl) {
          if (strncmp(piece, "User", 4) == 0) { finishReply(); return; }
          ui.appendBot("\n");
          gen.bot_text += "\n";
          gen.pending_nl = false;
        }
        if (strcmp(piece, "\n") == 0) {
          gen.pending_nl = true;
        } else {
          ui.appendBot(piece);
          gen.bot_text += piece;
        }
      } else {
        ui.appendBot(piece);
      }
    }
    gen.tokens_out++;
  }
  gen.token = gen.next;
  gen.pos++;
  gen.abspos++;   // absolute position keeps climbing (clamped to seq_len in forward)
}

static void setup() {
  auto cfg = M5.config();
  M5.begin(cfg);
  Keyboard.begin();    // picks IOMatrix or TCA8418 reader from M5.getBoard()
  ui.begin();

  ui.status("TinyStories booting...");
  initModel();

  ui.ready();
  ui.statusf("%s  T=%.1f  /new resets  [tab] settings",
             transformer.config.arch != ARCH_GPTNEO ? "TinyLLama-v0" :
             transformer.config.dim > 128 ? "TinyTalk-2 8M" : "TinyTalk-2 3M",
             settings.temp);
  state = ST_CHAT;
}

static void loop() {
  M5.update();
  Keyboard.updateKeyList();
  Keyboard.updateKeysState();

  if (state == ST_SETTINGS) {
    if (Keyboard.isChange() && Keyboard.isPressed()) {
      auto st = Keyboard.keysState();
      if (st.tab || st.enter) { leaveSettings(); return; }
      for (char c : st.word) {
        if (c == ';') { sett_sel = (sett_sel + SETT_N - 1) % SETT_N; drawSettings(); }
        if (c == '.') { sett_sel = (sett_sel + 1) % SETT_N; drawSettings(); }
        if (c == ',') adjustSetting(-1);
        if (c == '/') adjustSetting(+1);
      }
    }
    return;
  }
  if (state != ST_CHAT) return;

  if (gen.active) {
    ui.tickGenerating(gen.tokens_out);
    if (Keyboard.isChange() && Keyboard.isPressed()) {
      auto st = Keyboard.keysState();
      for (char c : st.word) {
        if (c == '`') { finishReply(); return; }
      }
    }
    stepGeneration();
    return;
  }
  if (Keyboard.isChange() && Keyboard.isPressed()) {
    auto st = Keyboard.keysState();
    if (st.tab) {                      // open settings (only when idle)
      state = ST_SETTINGS;
      sett_sel = 0;
      drawSettings();
      return;
    }
    if (st.fn) {
      // fn+; / fn+. are the up/down arrows on the Cardputer keyboard —
      // scroll the chat history (2 lines per press).
      for (char c : st.word) {
        if (c == ';') ui.scrollChat(+2);
        if (c == '.') ui.scrollChat(-2);
        if (c == 'u') ui.toggleTranslit();   // Ukrainian <-> Latin input
      }
    } else {
      for (char c : st.word) ui.onChar(c);
      if (st.del)   ui.onBackspace();
      if (st.enter) {
        std::string prompt = ui.takeInput();
        if (prompt == "/new") {
          historyClear();
          ui.statusf("new conversation  [tab] settings");
        } else if (prompt.length()) {
          ui.appendUser(prompt);
          beginGeneration(prompt);
        }
      }
    }
  }
}

extern "C" void app_main(void) {
  setup();
  for (;;) {
    loop();
    // Full speed while generating (one token per iteration); when idle, a
    // 1 ms tick (CONFIG_FREERTOS_HZ=1000) is plenty for keyboard polling.
    if (!gen.active) vTaskDelay(1);
  }
}
